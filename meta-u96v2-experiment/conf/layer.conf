## meta-u96v2-experiment/conf/layer.conf
```bitbake
# We have a conf and classes directory, add to BBPATH
BBPATH .= ":${LAYERDIR}"

# We have recipes-* directories, add to BBFILES
BBFILES += "${LAYERDIR}/recipes-*/*/*.bb \
	${LAYERDIR}/recipes-*/*/*.bbappend"

BBFILE_COLLECTIONS += "meta-u96v2-exp"
BBFILE_PATTERN_meta-u96v2-exp = "^${LAYERDIR}/"
BBFILE_PRIORITY_meta-u96v2-exp = "8"
LAYERSERIES_COMPAT_meta-u96v2-exp = "honister langdale"
```
